// Reuse production keymap, transform, axis convention and scroll override.
// Only the split transport, GPIO scanner and PS/2 transducer are replaced.
#include "../../config/tapir.keymap"
#include "../../config/boards/shields/tapir/tapir-transform.dtsi"
#include "../../config/boards/shields/tapir/tapir-listener.dtsi"
#include <dt-bindings/zmk/kscan_mock.h>

/ {
    chosen { zmk,matrix-transform = &default_transform; };
    stick: mock_input {
        compatible = "zmk,input-mock";
        event-startup-delay = <85>;
        event-period = <80>;
        events = <INPUT_EV_REL INPUT_REL_X 12 1>,
                 <INPUT_EV_REL INPUT_REL_Y 12 1>,
                 <INPUT_EV_REL INPUT_REL_X 12 1>,
                 <INPUT_EV_REL INPUT_REL_X 24 1>,
                 <INPUT_EV_REL INPUT_REL_Y (-36) 1>,
                 <INPUT_EV_REL INPUT_REL_Y 24 1>,
                 <INPUT_EV_REL INPUT_REL_X 12 1>,
                 <INPUT_EV_REL INPUT_REL_X 12 1>;
        exit-after;
    };
};

&kscan {
    rows = <4>;
    columns = <12>;
    /delete-property/ exit-after;
    events = <ZMK_MOCK_PRESS(3,0,100) ZMK_MOCK_RELEASE(3,0,90)
              ZMK_MOCK_PRESS(3,1,180) ZMK_MOCK_RELEASE(3,1,50)
              ZMK_MOCK_PRESS(3,2,60) ZMK_MOCK_RELEASE(3,2,30)>;
};
