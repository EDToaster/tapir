## tapir/product/firmware/config/boards/shields/tapir/Kconfig.defconfig
```kconfig
if SHIELD_TAPIR_LEFT || SHIELD_TAPIR_RIGHT

config ZMK_SPLIT
    default y

config ZMK_KEYBOARD_NAME
    default "Tapir"

endif

if SHIELD_TAPIR_RIGHT

config ZMK_SPLIT_ROLE_CENTRAL
    default y

endif
```

## tapir/product/firmware/config/boards/shields/tapir/Kconfig.shield
```kconfig
config SHIELD_TAPIR_LEFT
    def_bool $(shields_list_contains,tapir_left)

config SHIELD_TAPIR_RIGHT
    def_bool $(shields_list_contains,tapir_right)
```

## tapir/product/firmware/config/west.yml
```yaml
# Resolved EDToaster Corne v0.3.0 graph; import only modules used by these boards.
manifest:
  remotes:
    - {name: zmkfirmware, url-base: https://github.com/zmkfirmware}
    - {name: badjeff, url-base: https://github.com/badjeff}
  projects:
    - name: zmk
      remote: zmkfirmware
      revision: edf5c0814fd3ea202e43aad2d68fd32e882a518c
      clone-depth: 1
      import:
        file: app/west.yml
        name-allowlist: [nanopb, zmk-studio-messages]
    - name: zephyr
      remote: zmkfirmware
      revision: dacab4875df72109b96cc8977547a0dc04875bcd
      clone-depth: 1
      import:
        name-allowlist: [cmsis, hal_nordic, tinycrypt, segger, lvgl]
    - name: kb_zmk_ps2_mouse_trackpoint_driver
      remote: badjeff
      revision: 5ff0b24863ab74390adcc447b0575fcd78442514
      clone-depth: 1
  self:
    path: config
```

## tapir/product/firmware/dts/bindings/tapir,pointer-rail.yaml
```yaml
description: Tapir switched Sprintek rail (right central only)
compatible: "tapir,pointer-rail"
include: base.yaml
properties:
  enable-gpios:
    type: phandle-array
    required: true
```
